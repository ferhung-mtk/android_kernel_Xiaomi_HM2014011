## kernel-3.10/drivers/misc/mediatek/accelerometer/Kconfig
```kconfig
config MTK_LSM330_AUTO
	bool "MTK_LSM330_AUTO for MediaTek package"
	default n

config MTK_BMI058
	bool "MTK_BMI058 for MediaTek package"
	default n
```

## kernel-3.10/drivers/misc/mediatek/alsps/Kconfig
```kconfig
config MTK_STK3X1X
	bool "MTK_STK3X1X for MediaTek package"
	default n

config MTK_LTR553
	bool "MTK_LTR553 for MediaTek package"
	default n

config MTK_LTR558
	bool "MTK_LTR558 for MediaTek package"
	default n
```

## kernel-3.10/drivers/misc/mediatek/gyroscope/Kconfig
```kconfig
config MTK_L3GD20
	bool "MTK_L3GD20 for MediaTek package"
	default n

config MTK_BMG160
	bool "MTK_BMG160 for MediaTek package"
	default n

config MTK_BMI058
	bool "MTK_BMI058 for MediaTek package"
	default n
```

## kernel-3.10/drivers/misc/mediatek/magnetometer/Kconfig
```kconfig
config MTK_AKM8963
	bool "MTK_AKM8963 for MediaTek package"
	default n

config MTK_HSCDTD006_AUTO
	bool "MTK_HSCDTD006_AUTO for MediaTek package"
	default n
```
